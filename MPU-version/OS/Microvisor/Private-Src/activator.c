#include <stdint.h>
#include "activator.h"
#include "permanent_storage.h"
#include "microvisor_config.h"
#include "error.h"

uint8_t Activation_Server_IP[] = {192,168,1,168};	// activation server IP
uint16_t ACTIVATION_SERVER_PORT = 25565;	// activation server port

/* Activation server public key (DER format) */
const uint8_t Activation_Server_PubKey[ACTIVATION_SERVER_PUBKEY_LEN] = {
	0x30, 0x82, 0x01, 0x0a, 0x02, 0x82, 0x01, 0x01, 0x00, 0xbf, 0xa5, 0x47, 0x88, 0x93, 0x92, 0x0e,
	0x3a, 0xeb, 0xd8, 0xcf, 0x27, 0x6d, 0x2f, 0x27, 0x8b, 0x6d, 0xb5, 0x62, 0x2d, 0x41, 0xe6, 0x36,
	0x7c, 0x8a, 0xbc, 0xe4, 0xb2, 0x98, 0xa5, 0x95, 0xf9, 0x24, 0xc6, 0x6c, 0xb4, 0xbf, 0x09, 0x21,
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	0xa4, 0x87, 0xd5, 0x8f, 0xfb, 0x62, 0x0e, 0xe8, 0xeb, 0x02, 0x03, 0x01, 0x00, 0x01
};

/**
 * Compute the hash of the UUID of the board and compare it to the value already stored 
 * in the permanent memory. If the values match, the board was already activated
 * 
 * Returns:
 * 1 if the board is activated, 0 otherwise
*/
uint32_t activator_is_board_activated() {
	/* compute UUID hash  */
	uint8_t temp[PERMA_STORAGE_ACTIVATION_CODE_LEN];
	volatile uint32_t status;
	status = mbedtls_sha256((uint8_t *) STM32L4XX_UID, STM32L4XX_UID_LEN, temp, 0);
	if(status != 0)
		return 0;
	/* compare stored activation code with UUID hash */
	for(uint32_t i = 0; i < PERMA_STORAGE_ACTIVATION_CODE_LEN; i++) {
		if(temp[i] != PERMA_STORAGE->activation_code[i])
			return 0;
	}
	return 1;
}

/**
 * Send an activation request to the MCU-Fortifier activation server and store the received
 * activation code in the permanent memory
 * 
 * Parameters:
 * ctx: the context used to communicate securely with the activation server
 * 
 * Returns:
 * ACTIVATOR_OK if the activation was successful, ACTIVATOR_ERROR otherwise
*/
uint32_t activator_activate_board(sec_comm_context* ctx) {
	uint32_t msg_id = ACTIVATOR_ACTIVATION_REQUEST;
	uint8_t buffer[PERMA_STORAGE_ACTIVATION_CODE_LEN];

	/* Compose and write board activation message */
	if(sec_comm_send(ctx, (unsigned char *) &msg_id, 4) != 4) {	// send message id
		return ACTIVATOR_COMMUNICATION_ERROR;
	}
	if(sec_comm_send(ctx, (unsigned char *) &license, LICENSE_LEN) != LICENSE_LEN) {	// send stored license
		return ACTIVATOR_COMMUNICATION_ERROR;
	}
	if(sec_comm_send(ctx, (unsigned char *) STM32L4XX_UID, STM32L4XX_UID_LEN) != STM32L4XX_UID_LEN) {	// send board UID
		return ACTIVATOR_COMMUNICATION_ERROR;
	}

	/* Parse reply */
	if(sec_comm_recv(ctx, buffer, 4) != 4) {	// read 4 bytes message id
		return ACTIVATOR_COMMUNICATION_ERROR;
	}
	if(*((int *) buffer) != ACTIVATOR_ACTIVATION_REPLY) {
		return ACTIVATOR_UNEXPECTED_REPLY;
	}
	if(sec_comm_recv(ctx, buffer, 4) != 4) {	// read activation result
		return ACTIVATOR_COMMUNICATION_ERROR;
	}

	/* Check activation result */
	switch(*(uint32_t *) buffer) {
		case ACTIVATOR_ACTIVATION_OK:
			break;
		case ACTIVATOR_INVALID_LICENSE:
			perma_storage_store_error(ERROR_INVALID_LICENSE, NULL, ERROR_INVALID_LICENSE_LEN);
			return ACTIVATOR_ERROR;
		case ACTIVATOR_LICENSE_LIMIT_EXCEEDED:
			perma_storage_store_error(ERROR_LICENSE_LIMIT_EXCEEDED, NULL, ERROR_LICENSE_LIMIT_EXCEEDED_LEN);
			return ACTIVATOR_ERROR;
		default:
			return ACTIVATOR_ERROR;
	}

	/* Read activation code */
	if(sec_comm_recv(ctx, buffer, (PERMA_STORAGE_ACTIVATION_CODE_LEN)) != (PERMA_STORAGE_ACTIVATION_CODE_LEN)) {	// read 256 bit activation code
		return ACTIVATOR_COMMUNICATION_ERROR;
	}

	/* Store activation code received on permanent storage */
	uint32_t status = perma_storage_set_activation_code(buffer);
	if(status != PERMA_STORAGE_OK)
		return ACTIVATOR_ERROR;

	return ACTIVATOR_OK;
}